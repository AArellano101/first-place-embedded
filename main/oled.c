#include "oled.h"
#include "box_settings.h"
#include <string.h>
#include "esp_lcd_panel_io.h"
#include "esp_lcd_panel_ops.h"
#include "esp_lcd_panel_vendor.h"

#define WIDTH OLED_WIDTH
#define CELL_WIDTH 6
static esp_lcd_panel_handle_t panel;
static unsigned display_height;
static uint8_t pixels[WIDTH * 64 / 8];

// Printable ASCII 32..126; five columns per glyph, top pixel in bit 0.
static const uint8_t font[95][5] = {
    {0,0,0,0,0}, {0,0,0x5f,0,0}, {0,7,0,7,0},
    {0x14,0x7f,0x14,0x7f,0x14}, {0x24,0x2a,0x7f,0x2a,0x12},
    {0x23,0x13,8,0x64,0x62}, {0x36,0x49,0x55,0x22,0x50}, {0,0,7,0,0},
    {0,0x1c,0x22,0x41,0}, {0,0x41,0x22,0x1c,0},
    {0x14,8,0x3e,8,0x14}, {8,8,0x3e,8,8}, {0,0x50,0x30,0,0},
    {8,8,8,8,8}, {0,0x60,0x60,0,0}, {0x20,0x10,8,4,2},
    // 0..9
    {0x3e,0x51,0x49,0x45,0x3e}, {0,0x42,0x7f,0x40,0},
    {0x42,0x61,0x51,0x49,0x46}, {0x21,0x41,0x45,0x4b,0x31},
    {0x18,0x14,0x12,0x7f,0x10}, {0x27,0x45,0x45,0x45,0x39},
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    {0x32,0x49,0x79,0x41,0x3e},
    // A..Z
    {0x7e,9,9,9,0x7e}, {0x7f,0x49,0x49,0x49,0x36},
    {0x3e,0x41,0x41,0x41,0x22}, {0x7f,0x41,0x41,0x22,0x1c},
    {0x7f,0x49,0x49,0x49,0x41}, {0x7f,9,9,9,1},
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    {4,2,1,2,4}, {0x40,0x40,0x40,0x40,0x40}, {0,1,2,4,0},
    // a..z
    {0x20,0x54,0x54,0x54,0x78}, {0x7f,0x48,0x44,0x44,0x38},
    {0x38,0x44,0x44,0x44,0x20}, {0x38,0x44,0x44,0x48,0x7f},
    {0x38,0x54,0x54,0x54,0x18}, {8,0x7e,9,1,2},
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    {0,8,0x36,0x41,0}, {0,0,0x7f,0,0}, {0,0x41,0x36,8,0}, {8,4,8,0x10,8},
};

esp_err_t oled_init(i2c_master_bus_handle_t bus, uint8_t address, unsigned height)
{
    if (!bus || (height != 32 && height != 64) || address > 0x7f) {
        return ESP_ERR_INVALID_ARG;
    }
    if (panel) return ESP_ERR_INVALID_STATE;
    esp_lcd_panel_io_handle_t io = NULL;
    const esp_lcd_panel_io_i2c_config_t io_config = {
        .dev_addr = address,
        .scl_speed_hz = OLED_I2C_HZ,
        .control_phase_bytes = 1,
        .dc_bit_offset = 6,
        .lcd_cmd_bits = 8,
        .lcd_param_bits = 8,
    };
    esp_err_t err = esp_lcd_new_panel_io_i2c(bus, &io_config, &io);
    if (err != ESP_OK) return err;
    esp_lcd_panel_ssd1306_config_t vendor = {.height = height};
    const esp_lcd_panel_dev_config_t config = {
        .reset_gpio_num = -1,
        .bits_per_pixel = 1,
        .vendor_config = &vendor,
    };
    err = esp_lcd_new_panel_ssd1306(io, &config, &panel);
    if (err != ESP_OK) goto fail;
    display_height = height;
    if ((err = esp_lcd_panel_reset(panel)) != ESP_OK) goto fail;
    if ((err = esp_lcd_panel_init(panel)) != ESP_OK) goto fail;
    if ((err = esp_lcd_panel_mirror(panel, OLED_MIRROR_X, OLED_MIRROR_Y)) != ESP_OK) goto fail;
    oled_clear();
    if ((err = oled_show()) != ESP_OK) goto fail;
    if ((err = esp_lcd_panel_disp_on_off(panel, true)) != ESP_OK) goto fail;
    return ESP_OK;
fail:
    if (panel) esp_lcd_panel_del(panel);
    panel = NULL;
    display_height = 0;
    esp_lcd_panel_io_del(io);
    return err;
}

void oled_clear(void)
{
    memset(pixels, 0, sizeof(pixels));
}

void oled_write_text(unsigned column, unsigned row, const char *text)
{
    if (!text || column >= WIDTH / CELL_WIDTH) return;
    while (*text && row < display_height / 8) {
        unsigned char c = (unsigned char)*text++;
        if (c == '\n') {
            column = 0;
            row++;
            continue;
        }
        if (column >= WIDTH / CELL_WIDTH) {
            column = 0;
            if (++row >= display_height / 8) break;
        }
        if (c < 32 || c > 126) c = '?';
        uint8_t *cell = &pixels[row * WIDTH + column * CELL_WIDTH];
        memcpy(cell, font[c - 32], 5);
        cell[5] = 0;
        column++;
    }
}

esp_err_t oled_show(void)
{
    if (!panel) return ESP_ERR_INVALID_STATE;
    return esp_lcd_panel_draw_bitmap(panel, 0, 0, WIDTH, display_height, pixels);
}
